/* Extra overlay for Jolteon_Nordic_Schematic.pdf (2025-08-10).
 * PA22/TX1 -> nRF P1.05/RX; nRF P1.04/TX -> PA23/RX1.
 * P1.06 is the separate PA15/IRQ net and must not be used as UART RX.
 * Keep app.overlay for the original bridge carrier; apply this file AFTER it.
 */
&uart0_wt02e40e_default {
	group1 {
		psels = <NRF_PSEL(UART_TX, 1, 4)>, <NRF_PSEL(UART_RX, 1, 5)>;
	};
};
&uart0_wt02e40e_sleep {
	group1 {
		psels = <NRF_PSEL(UART_TX, 1, 4)>, <NRF_PSEL(UART_RX, 1, 5)>;
	};
};
